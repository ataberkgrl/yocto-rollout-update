## meta-rollout/conf/layer.conf
```bitbake
# We have a conf and classes directory, add to BBPATH
BBPATH .= ":${LAYERDIR}"

# We have recipes-* directories, add to BBFILES
BBFILES += "${LAYERDIR}/recipes-*/*/*.bb \
            ${LAYERDIR}/recipes-*/*/*.bbappend"

BBFILE_COLLECTIONS += "meta-rollout"
BBFILE_PATTERN_meta-rollout = "^${LAYERDIR}/"
BBFILE_PRIORITY_meta-rollout = "6"

LAYERDEPENDS_meta-rollout = "core"
LAYERSERIES_COMPAT_meta-rollout = "honister"
```
